## CMakeLists.txt
```
# Copyright 2025 The ChromiumOS Authors
# Use of this source code is governed by a BSD-style license that can be
# found in the LICENSE file.

cmake_minimum_required(VERSION 3.20.0)

list(APPEND BOARD_ROOT ${CMAKE_CURRENT_SOURCE_DIR})
set(BOARD dolos)

find_package(Zephyr REQUIRED HINTS $ENV{ZEPHYR_BASE})
project(bootloader)

FILE(GLOB src_c src/*.c)

target_sources(app PRIVATE ${src_c})
```

## prj.conf
```kconfig
# Copyright 2025 The ChromiumOS Authors
# Use of this source code is governed by a BSD-style license that can be
# found in the LICENSE file.

CONFIG_SERIAL=y
CONFIG_UART_INTERRUPT_DRIVEN=y

CONFIG_USE_DT_CODE_PARTITION=y

CONFIG_FLASH=y
CONFIG_FLASH_MAP=y

CONFIG_LTO=y
CONFIG_ISR_TABLES_LOCAL_DECLARATION=y

CONFIG_BOOT_BANNER=n

CONFIG_RING_BUFFER=y

CONFIG_REBOOT=y

CONFIG_CRC=y

CONFIG_LED=y
```

## src/main.c
```c
/* Copyright 2025 The ChromiumOS Authors
 * Use of this source code is governed by a BSD-style license that can be
 * found in the LICENSE file.
 */

#include "commands.h"
#include "uart.h"
#include "utils.h"

#include <zephyr/kernel.h>

#define MSG_SIZE 32
#define BOOT_TIMEOUT_SECONDS 10
#define BLINK_INTERVAL_SECONDS 1
#define PROMPT "\x1b[31mboot:~> \x1b[m"

K_TIMER_DEFINE(blink_timer, leds_callback, NULL);

int main(void)
{
	char cmd_buf[MSG_SIZE];
	int ret;

	uart_init();
	uart_print("\n*** Dolos bootloader startup ***\r\n");

	init_flags();

	k_timeout_t cmd_timeout = K_SECONDS(BOOT_TIMEOUT_SECONDS);
	uint8_t safe_to_boot = 1;

	if (check_firmware_CRC() != 0) {
		cmd_timeout = K_FOREVER;
		safe_to_boot = 0;
	} else if (check_dev_flag_set() == 0) {
		uart_print("Developer flag set -- skipping timeout\r\n");
		if (boot_main_image() != 0) {
			uart_print("Entering recovery mode...\r\n");
			uart_print("Waiting for user command\r\n");
			cmd_timeout = K_FOREVER;
		}
	}

	leds_init();
	k_timer_start(&blink_timer, K_SECONDS(BLINK_INTERVAL_SECONDS),
		      K_SECONDS(BLINK_INTERVAL_SECONDS));
	uart_print(PROMPT);
	while (1) {
		/* Wait for a command */
		ret = uart_receive_line(cmd_buf, sizeof(cmd_buf), cmd_timeout);

		if (ret == 0) {
			/* Command received from user */
			ret = process_command(cmd_buf, safe_to_boot);
			uart_print(PROMPT);
		} else if (ret == -EAGAIN) {
			/* Timeout occurred. Should not get here if validation
			   failed so it's safe to boot. */
			uart_print("\r\nTimeout reached. ");
			ret = boot_main_image();
		}

		if (ret != 0) {
			uart_print("Entering recovery mode...\r\n");
			uart_print("Waiting for user command\r\n");
			safe_to_boot = 0;
			cmd_timeout = K_FOREVER;
		}
	}
}
```

## src/commands.c
```c
/* Copyright 2025 The ChromiumOS Authors
 * Use of this source code is governed by a BSD-style license that can be
 * found in the LICENSE file.
 */

#include "app_version.h"
#include "commands.h"
#include "uart.h"
#include "utils.h"

#include <string.h>

#include <zephyr/kernel.h>
#include <zephyr/storage/flash_map.h>
#include <zephyr/sys/reboot.h>

typedef int (*command_handler_t)(void);

struct command_entry {
	const char *name;
	command_handler_t handler;
	const char *desc;
	// Flag to indicate if the command can be run even if CRC32 validation
	// fails
	const int always_safe;
};

static int command_boot(void);
static int command_bsl(void);
static int command_reset(void);
static int command_version(void);
static int command_help(void);

/*
 * Command dispatch table.
 */
static const struct command_entry command_table[] = {
	{ "reset", command_reset, "reboots the device", 1 },
	{ "bsl", command_bsl, "jumps to BSL", 1 },
	{ "boot", command_boot, "boots main image", 0 },
	{ "version", command_version, "prints bootloader version", 1 },
	{ "help", command_help, "prints help message", 1 },
	{ "boot_unsafe", command_boot,
	  "bypasses CRC32 validation and boots main image", 1 }
};

int process_command(char *buf, int safe_to_boot)
{
	for (int i = 0; i < ARRAY_SIZE(command_table); i++) {
		if (strcmp(buf, command_table[i].name) == 0) {
			if (command_table[i].always_safe == 0 &&
			    safe_to_boot == 0) {
				uart_print(
					"ERROR: Unsafe to execute this command in current state.\r\n");
				return -1;
			}
			return command_table[i].handler();
		}
	}

	uart_print("Unrecognized command\r\n");
	return 0;
}

/*
 * Command handler functions
 */

#define TABSTOP 8

static int command_help(void)
{
	uart_print("Available commands:\r\n");
	for (int i = 0; i < ARRAY_SIZE(command_table); i++) {
		uart_print(command_table[i].name);
		if (strlen(command_table[i].name) > TABSTOP) {
			uart_print("\t");
		} else {
			uart_print("\t\t");
		}
		uart_print("-- ");
		uart_print(command_table[i].desc);
		uart_print("\r\n");
	}
	return 0;
}

static int command_version(void)
{
	uart_print("Bootloader version ");
	uart_print(APP_VERSION_STRING);
	uart_print("\r\n");
	return 0;
}

static int command_reset(void)
{
	uart_print("Resetting device...\r\n");
	k_sleep(K_MSEC(100));
	sys_reboot(SYS_REBOOT_COLD);
	return 0;
}

static int command_bsl(void)
{
	jump_to_bsl();
	return 0;
}

static int command_boot(void)
{
	return boot_main_image();
}
```

## src/commands.h
```c
/* Copyright 2025 The ChromiumOS Authors
 * Use of this source code is governed by a BSD-style license that can be
 * found in the LICENSE file.
 */

#ifndef __COMMANDS_H__
#define __COMMANDS_H__

/**
 * @brief Processes a received command string.
 *
 * This function looks up the command in a command table and executes the
 * associated handler. If the command is not found, it prints an error.
 *
 * @param buf A null-terminated string containing the command to process.
 * @param safe_to_boot Flag to indicate if safe to boot or not.
 *
 * @retval 0 on success
 * @retval non-zero error code on failure
 */
int process_command(char *buf, int safe_to_boot);

#endif /* __COMMANDS_H__ */
```

## src/uart.c
```c
/* Copyright 2025 The ChromiumOS Authors
 * Use of this source code is governed by a BSD-style license that can be
 * found in the LICENSE file.
 */

#include "uart.h"

#include <ctype.h>
#include <string.h>

#include <zephyr/drivers/uart.h>
#include <zephyr/sys/ring_buffer.h>

#define UART_DEVICE_NODE DT_CHOSEN(zephyr_shell_uart)
static const struct device *const uart_dev = DEVICE_DT_GET(UART_DEVICE_NODE);

#define BUF_SIZE 1024

static K_SEM_DEFINE(rx_sem, 0, 1);
static char rx_buf[BUF_SIZE];
static uint8_t rx_pos;
RING_BUF_DECLARE(tx_buf, BUF_SIZE);

typedef enum { STATE_NORMAL, STATE_GOT_ESCAPE, STATE_IN_SEQUENCE } rx_state_t;

static rx_state_t state = STATE_NORMAL;

/**
 * @brief Processes a single received character.
 *
 *  The simple state machine used in this function has the purpose of filtering
 * out some of the common ANSI escape sequences, more specifically those
 * generated by a single keyboard button press. It is not an exhaustive filter.
 *
 *  If in the future, proper handling of such sequences is desired, the logic in
 * the corresponding states needs to be expanded and any necessary new states
 * added.
 *
 * @return false if a line-ending was found, true otherwise.
 */
static bool process_received_char(const struct device *dev, uint8_t c)
{
	switch (state) {
	case STATE_NORMAL:
		if (c == '\x1b') {
			// Detected start of an escape sequence
			state = STATE_GOT_ESCAPE;
		} else if (c == '\b' || c == 127) { // Handle backspace/delete
			if (rx_pos > 0) {
				rx_pos--;
				uart_print("\b \b");
			}
		} else if (c == '\r' || c == '\n') { // Handle newline/enter
			rx_buf[rx_pos] = '\0';
			rx_pos = 0;
			k_sem_give(&rx_sem);
			uart_print("\r\n");
			return false; // Signal end of line
		} else if (isprint(c) && rx_pos < BUF_SIZE - 1) {
			// Handle reglar characters
			rx_buf[rx_pos++] = c;
			char str_rep[2] = { c, 0 };
			uart_print(str_rep);
		}
		break;

	case STATE_GOT_ESCAPE:
		// The character after ESC determines the sequence type.
		// We will handle CSI '[' and other common introducers like 'O'.
		if (c == '[' || c == 'O') {
			state = STATE_IN_SEQUENCE;
		} else {
			// It's a two-character sequence we don't care about
			// We consume this character and return to normal.
			state = STATE_NORMAL;
		}
		break;

	case STATE_IN_SEQUENCE:
		// Final bytes are in the range 0x40 to 0x7E as per ECMA-48.
		if (0x40 <= c && c <= 0x7E) {
			state = STATE_NORMAL;
		}
		break;
	}
	return true;
}

static void uart_callback(const struct device *dev, void *user_data)
{
	uart_irq_update(dev);

	// Handle RX
	if (uart_irq_rx_ready(dev)) {
		uint8_t c;
		while (uart_fifo_read(dev, &c, sizeof(c)) == sizeof(c)) {
			if (!process_received_char(dev, c)) {
				break;
			}
		}
	}

	// Handle TX
	if (uart_irq_tx_ready(dev)) {
		uint8_t c;
		if (ring_buf_get(&tx_buf, &c, sizeof(c)) > 0) {
			uart_fifo_fill(dev, &c, sizeof(c));
		} else {
			uart_irq_tx_disable(dev);
		}
	}
}

void uart_init(void)
{
	int ret;
	ret = uart_irq_callback_user_data_set(uart_dev, uart_callback, NULL);
	if (ret < 0) {
		if (ret == -ENOTSUP) {
			printk("Interrupt-driven UART API support not enabled\n");
		} else if (ret == -ENOSYS) {
			printk("UART device does not support interrupt-driven API\n");
		} else {
			printk("Error setting UART callback: %d\n", ret);
		}
		return;
	}
	uart_irq_rx_enable(uart_dev);
}

void uart_print(const char *buf)
{
	while (*buf != 0) {
		ring_buf_put(&tx_buf, buf, sizeof(*buf));
		buf++;
	}
	uart_irq_tx_enable(uart_dev);
}

int uart_receive_line(char *buf, size_t size, k_timeout_t timeout)
{
	int ret = k_sem_take(&rx_sem, timeout);
	if (ret != 0) {
		return ret;
	}

	size_t pos = 0;
	while (rx_buf[pos] != 0) {
		buf[pos] = rx_buf[pos];
		pos++;
	}
	buf[pos] = '\0';
	return 0;
}
```

## src/uart.h
```c
/* Copyright 2025 The ChromiumOS Authors
 * Use of this source code is governed by a BSD-style license that can be
 * found in the LICENSE file.
 */

#ifndef __UART_H__
#define __UART_H__

#include <zephyr/kernel.h>

/**
 * @brief Initializes the UART driver and ring buffers.
 */
void uart_init(void);

/**
 * @brief Sends a string over UART using the TX ring buffer.
 *
 * @param buf The string to send.
 */
void uart_print(const char *buf);

/**
 * @brief Receives a line from the RX ring buffer.
 *
 * This function waits for a complete line (terminated by '\r' or '\n')
 * to be available in the buffer.
 *
 * @param buf The buffer to store the received line.
 * @param size The size of the buffer.
 * @param timeout The timeout for waiting for data.
 * @return 0 on success, -EAGAIN on timeout.
 */
int uart_receive_line(char *buf, size_t size, k_timeout_t timeout);

#endif /* __UART_H__ */
```

## src/utils.c
```c
/* Copyright 2025 The ChromiumOS Authors
 * Use of this source code is governed by a BSD-style license that can be
 * found in the LICENSE file.
 */

#include "uart.h"
#include "utils.h"

#include <string.h>

#include <zephyr/drivers/led.h>
#include <zephyr/storage/flash_map.h>
#include <zephyr/sys/crc.h>

#define RO_RECORD_SIZE 32
#define DEV_FLAG_OFFSET 0
#define DEV_FLAG_MASK 0x1

static char flags[RO_RECORD_SIZE];

enum ro_record_offset {
	RO_RECORD_OFFSET_VERSION = 0,
	RO_RECORD_OFFSET_FLAGS = RO_RECORD_SIZE,
	RO_RECORD_OFFSET_UNUSED_1 = 2 * RO_RECORD_SIZE,
	RO_RECORD_OFFSET_UNUSED_2 = 3 * RO_RECORD_SIZE
};

enum firmware_trailer_offset { FIRMWARE_TRAILER_OFFSET_CRC = 0 };

static const struct device *leds = DEVICE_DT_GET(DT_NODELABEL(leds));

#define NUM_LEDS 4
static bool leds_state = false;

void init_flags(void)
{
	const struct flash_area *ro_partition;
	if (flash_area_open(FIXED_PARTITION_ID(ro_partition), &ro_partition) !=
	    0) {
		uart_print("ERROR: Unable to open RO partition. ");
		uart_print("Proceeding with default settings\r\n");
		return;
	}

	// Read flags
	if (flash_area_read(ro_partition, RO_RECORD_OFFSET_FLAGS, flags,
			    RO_RECORD_SIZE) != 0) {
		uart_print("ERROR: Unable to read flags. ");
		uart_print("Proceeding with default settings\r\n");
		// Init flags to flash erase value which is treated as disabled
		memset(flags, 0xff, RO_RECORD_SIZE);
	}
}

int check_dev_flag_set(void)
{
	return (uint8_t)DEV_FLAG_MASK & flags[DEV_FLAG_OFFSET];
}

int boot_main_image(void)
{
	const struct flash_area *app_partition;

	// 1. Find the application partition using the flash map API.
	if (flash_area_open(FIXED_PARTITION_ID(firmware_partition),
			    &app_partition) != 0) {
		uart_print("FATAL: Main application partition not found!\r\n");
		return -1;
	}

	uart_print("Booting main image...\r\n");
	k_sleep(K_MSEC(100));

	uint32_t app_code_start_addr = app_partition->fa_off;
	flash_area_close(app_partition);

	// 2. Disable interrupt response.
	__disable_irq();

	// 3. Disable all enabled interrupts in NVIC.
	memset((uint32_t *)NVIC->ICER, 0xFF, sizeof(NVIC->ICER));

	// 4. Clear all pending interrupt requests in NVIC.
	memset((uint32_t *)NVIC->ICPR, 0xFF, sizeof(NVIC->ICPR));

	// 5. Disable SysTick and clear its exception pending bit.
	SysTick->CTRL = 0;
	SCB->ICSR |= SCB_ICSR_PENDSTCLR_Msk;

	/* 6. Load the vector table address of user application code in to VTOR.
	 *     The application's vector table is at its start address.
	 */
	SCB->VTOR = app_code_start_addr;

	/* 7. Use the MSP as the current SP.
	 * Set the MSP with the value from the vector table used by the
	 * application.
	 */
	__set_MSP(((uint32_t *)(SCB->VTOR))[0]);

	// In thread mode, enable privileged access and use the MSP as the
	// current SP.
	__set_CONTROL(0);

	// 8. Enable interrupts.
	__enable_irq();

	// 9. Jump to the application's reset handler
	uint32_t reset_handler_address = ((uint32_t *)(SCB->VTOR))[1];
	void (*app_reset_handler)(void) = (void (*)(void))reset_handler_address;
	app_reset_handler();

	// Not reaching this point
	__builtin_unreachable();
}

void jump_to_bsl(void)
{
	uart_print("Jumping to BSL...\r\n");
	k_sleep(K_MSEC(100));
	__asm(
#if defined(__GNUC__)
		".syntax unified\n"
#endif
		"ldr     r4, = 0x41C40018\n"
		"ldr     r4, [r4]\n"
		"ldr     r1, = 0x03FF0000\n"
		"ands    r4, r1\n"
		"lsrs    r4, r4, #6\n"
		"ldr     r1, = 0x20300000\n"
		"adds    r2, r4, r1\n"
		"movs    r3, #0\n"
		"init_ecc_loop: \n"
		"str     r3, [r1]\n"
		"adds    r1, r1, #4\n"
		"cmp     r1, r2\n"
		"blo     init_ecc_loop\n"
		"ldr     r1, = 0x20200000\n"
		"adds    r2, r4, r1\n"
		"movs    r3, #0\n"
		"init_data_loop:\n"
		"str     r3, [r1]\n"
		"adds    r1, r1, #4\n"
		"cmp     r1, r2\n"
		"blo     init_data_loop\n"
		"str     %[resetLvlVal], [%[resetLvlAddr], #0x00]\n"
		"str     %[resetCmdVal], [%[resetCmdAddr], #0x00]"
		: /* No outputs */
		: [resetLvlAddr] "r"(&SYSCTL->SOCLOCK.RESETLEVEL),
		  [resetLvlVal] "r"(DL_SYSCTL_RESET_BOOTLOADER_ENTRY),
		  [resetCmdAddr] "r"(&SYSCTL->SOCLOCK.RESETCMD),
		  [resetCmdVal] "r"(SYSCTL_RESETCMD_KEY_VALUE |
				    SYSCTL_RESETCMD_GO_TRUE)
		: "r1", "r2", "r3", "r4");

	__builtin_unreachable();
}

int check_firmware_CRC(void)
{
	const struct flash_area *firmware_trailer, *firmware_partition;

	if (flash_area_open(FIXED_PARTITION_ID(firmware_trailer),
			    &firmware_trailer) != 0) {
		uart_print("FATAL: Failed to open firmware trailer!\r\n");
		return -1;
	}

	uint32_t stored_crc;
	if (flash_area_read(firmware_trailer, FIRMWARE_TRAILER_OFFSET_CRC,
			    &stored_crc, sizeof(stored_crc)) != 0) {
		uart_print("FATAL: Failed to read stored firmware CRC\r\n");
		flash_area_close(firmware_trailer);
		return -1;
	}
	flash_area_close(firmware_trailer);

	if (flash_area_open(FIXED_PARTITION_ID(firmware_partition),
			    &firmware_partition) != 0) {
		uart_print("FATAL: Failed to open firmware partition!\r\n");
		return -1;
	}

	uint32_t computed_crc = 0;
	static uint8_t read_buf[256];
	size_t bytes_to_read;
	size_t bytes_processed = 0;
	size_t total_bytes = firmware_partition->fa_size;

	while (bytes_processed < total_bytes) {
		bytes_to_read =
			MIN(sizeof(read_buf), total_bytes - bytes_processed);
		if (flash_area_read(firmware_partition, bytes_processed,
				    read_buf, bytes_to_read) != 0) {
			uart_print(
				"FATAL: Flash read failed during CRC computation.\r\n");
			flash_area_close(firmware_partition);
			return -1;
		}

		computed_crc = crc32_ieee_update(computed_crc, read_buf,
						 bytes_to_read);
		bytes_processed += bytes_to_read;
	}

	flash_area_close(firmware_partition);

	int rc;
	if (stored_crc == computed_crc) {
		uart_print("CRC verification successful.\r\n");
		rc = 0;
	} else {
		uart_print("FATAL: CRC verification failed!\r\n");
		rc = -1;
	}

	char print_buf[40];
	sprintf(print_buf, "Expected: 0x%08x\r\n", stored_crc);
	uart_print(print_buf);
	sprintf(print_buf, "Actual:   0x%08x\r\n", computed_crc);
	uart_print(print_buf);

	return rc;
}

void leds_init(void)
{
	leds_state = true;
	for (int i = 0; i < NUM_LEDS; i++) {
		led_on(leds, i);
	}
}

void leds_callback(struct k_timer *timer)
{
	for (int i = 0; i < NUM_LEDS; i++) {
		if (leds_state == false) {
			led_on(leds, i);
		} else {
			led_off(leds, i);
		}
	}
	leds_state = !leds_state;
}
```

## src/utils.h
```c
/* Copyright 2025 The ChromiumOS Authors
 * Use of this source code is governed by a BSD-style license that can be
 * found in the LICENSE file.
 */

#ifndef __UTILS_H__
#define __UTILS_H__

#include <zephyr/kernel.h>

/**
 * @brief Boots the main application image.
 *
 * Jumps to the main application's code in a separate flash partition.
 * @retval noreturn on success
 * @retval negative value on failure
 */
int boot_main_image(void);

/**
 * @brief Jumps to BSL
 *
 * This function enters the BSL ROM bootloader and does not return.
 */
void __attribute__((noreturn)) jump_to_bsl(void);

/**
 * @brief Initializes flags from flash.
 *
 * Reads flags from a read-only flash partition to configure bootloader
 * behavior. If the read fails, the flags are set to a default disabled state.
 */
void init_flags(void);

/**
 * @brief Checks if the development flag is set.
 *
 * @retval 0 if flag is set
 * @retval non-zero value if flag is not set
 */
int check_dev_flag_set(void);

/**
 * @brief Checks if the stored CRC32 matches the computed CRC32 of the firmware
 *
 * @retval 0 if they match
 * @retval non-zero if different
 */
int check_firmware_CRC(void);

/**
 * @brief Initializes the LEDs by turning them all on.
 *
 * This function sets the initial state of all LEDs to ON. It should be
 * called once during startup before the blinking timer is activated.
 */
void leds_init(void);

/**
 * @brief Toggles the state of all LEDs for blinking.
 *
 * This function is designed to be used as a callback for a k_timer.
 * Each time it's called, it inverts the state of all configured LEDs
 * (from ON to OFF or OFF to ON), creating a blinking effect.
 *
 * @param timer A pointer to the timer instance that triggered the callback.
 * Unused.
 */
void leds_callback(struct k_timer *timer);

#endif /* __UTILS_H__ */
```
